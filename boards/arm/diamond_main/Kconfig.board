## boards/arm/diamond_main/Kconfig.board
```kconfig
config BOARD_DIAMOND_MAIN
	bool "Main board on Diamond Orb"
	depends on SOC_STM32G474XX
```

## boards/arm/diamond_main/Kconfig.defconfig
```kconfig
# STM32G474RE main MCU board configuration for Diamond Orb

config BOARD
	default "diamond_main"

config USE_STM32_LL_ADC
	default y

config I2C_INIT_PRIO_INST_1
    int "I2C init priority instance 1 (i2c3) - always-on I2C"
    default I2C_INIT_PRIORITY
    depends on I2C

config I2C_INIT_PRIO_INST_2
    int "I2C init priority instance 2 (i2c4) - battery I2C (SMBus)"
    default I2C_INIT_PRIORITY
    depends on I2C

config PCA95XX_INIT_PRIO_INST_0
    int "PCA95xx init priority instance 0 (on i2c1)"
    default GPIO_PCA95XX_INIT_PRIORITY
    depends on GPIO_PCA95XX
```

## boards/arm/diamond_main/diamond_main_defconfig
```kconfig
# SPDX-License-Identifier: Apache-2.0
CONFIG_BOARD_DIAMOND_MAIN=y

CONFIG_SOC_SERIES_STM32G4X=y
CONFIG_SOC_STM32G474XX=y

# Enable Clocks
CONFIG_CLOCK_CONTROL=y

# Enable MPU
CONFIG_ARM_MPU=y

# Enable HW stack protection
CONFIG_HW_STACK_PROTECTION=y

# sector size for the external SPI flash layout
# not using the default (64K) allows us to have the scratch partition in
# the STM32 Flash (faster access) as the scratch partition should be at
# least the size of the largest sector size of any Flash used by the
# bootloader
CONFIG_SPI_NOR_FLASH_LAYOUT_PAGE_SIZE=16384
```

## boards/arm/mcu_main/Kconfig.board
```kconfig
config BOARD_MCU_MAIN_V31
	bool "Orb main microcontroller"
	depends on SOC_STM32G474XX
```

## boards/arm/mcu_main/Kconfig.defconfig
```kconfig
# STM32G474RE main MCU board configuration

config BOARD
	default "mcu_main"

config SPI_STM32_INTERRUPT
	default y
	depends on SPI

config USE_STM32_LL_ADC
	default y
```

## boards/arm/orb/Kconfig.defconfig
```kconfig
# STM32G474RE Nucleo board configuration

# Copyright (c) 2019 STMicroelectronics.
# SPDX-License-Identifier: Apache-2.0

if BOARD_ORB

config BOARD
	default "orb"

config SPI_STM32_INTERRUPT
	default y
	depends on SPI

endif # BOARD_ORB
```

## boards/arm/pearl_main/Kconfig.board
```kconfig
config BOARD_PEARL_MAIN
	bool "Main board on Pearl Orb"
	depends on SOC_STM32G474XX
```

## boards/arm/pearl_main/Kconfig.defconfig
```kconfig
# STM32G474RE main MCU board configuration on Pearl board

config BOARD
	default "pearl_main"

config SPI_STM32_INTERRUPT
	default y
	depends on SPI

config USE_STM32_LL_ADC
	default y
```

## boards/arm/stm32g484_eval/Kconfig.board
```kconfig
# STM32G484 EVAL board configuration

# Copyright (c) 2019 STMicroelectronics.
# SPDX-License-Identifier: Apache-2.0

config BOARD_STM32G484_EVAL
	bool "STM32G484 Eval Board"
	depends on SOC_STM32G484XX
```

## boards/arm/stm32g484_eval/Kconfig.defconfig
```kconfig
# STM32G484 Eval board configuration

if BOARD_STM32G484_EVAL

config BOARD
	default "stm32g484_eval"

config SPI_STM32_INTERRUPT
	default y
	depends on SPI

endif # BOARD_STM32G484_EVAL
```

## boards/arm/stm32g4_discovery/Kconfig.board
```kconfig
# STM32G4 DISCO board configuration

# Copyright (c) 2019 STMicroelectronics.
# SPDX-License-Identifier: Apache-2.0

config BOARD_STM32G4_DISCOVERY
	bool "STM32G4 Discovery Development Board"
	depends on SOC_STM32G474XX
```

## boards/arm/stm32g4_discovery/Kconfig.defconfig
```kconfig
# STM32G474RE Discovery board configuration

# Copyright (c) 2019 STMicroelectronics.
# SPDX-License-Identifier: Apache-2.0

if BOARD_STM32G4_DISCOVERY

config BOARD
	default "stm32g4_discovery"

config SPI_STM32_INTERRUPT
	default y
	depends on SPI

endif # BOARD_STM32G4_DISCOVERY
```

## boards/tfh/diamond_main/diamond_main_defconfig
```kconfig
# SPDX-License-Identifier: Apache-2.0

# Enable Clocks
CONFIG_CLOCK_CONTROL=y

# Enable MPU
CONFIG_ARM_MPU=y

# Enable HW stack protection
CONFIG_HW_STACK_PROTECTION=y

# sector size for the external SPI flash layout
# not using the default (64K) allows us to have the scratch partition in
# the STM32 Flash (faster access) as the scratch partition should be at
# least the size of the largest sector size of any Flash used by the
# bootloader
CONFIG_SPI_NOR_FLASH_LAYOUT_PAGE_SIZE=16384
CONFIG_SPI_NOR_INIT_PRIORITY=52
```

## boards/tfh/pearl_main/pearl_main_defconfig
```kconfig
# SPDX-License-Identifier: Apache-2.0

# Enable Clocks
CONFIG_CLOCK_CONTROL=y

# Enable MPU
CONFIG_ARM_MPU=y

# Enable HW stack protection
CONFIG_HW_STACK_PROTECTION=y
```

## drivers/Kconfig
```kconfig
rsource "led_strip/Kconfig"
rsource "sensor/Kconfig"
rsource "mux_gpio/Kconfig"
rsource "i2c_spi_bridge/Kconfig"
rsource "optics/Kconfig"
```

## drivers/i2c_mux_gpio/Kconfig
```kconfig
# I2C_MUX_GPIO gpio-based I2C bus multiplexer

config I2C_MUX_GPIO
    bool "I2C_MUX_GPIO gpio-based I2C bus multiplexer"
    depends on I2C
    help
        Enable driver for gpio-based I2C bus multiplexer.

config I2C_MUX_GPIO_INIT_PRIO
    int "I2C_MUX_GPIO init priority"
    depends on I2C_MUX_GPIO
    default 65

config I2C_MUX_GPIO_CHANNEL_INIT_PRIO
    int "I2C_MUX_GPIO init priority"
    depends on I2C_MUX_GPIO
    default 66
```

## drivers/i2c_spi_bridge/Kconfig
```kconfig
# SC18IS606 I2C-SPI bridge configuration options

config SC18IS606
    bool "SC18IS606 I2C-SPI bridge"
    depends on I2C
    help
        Enable driver for SC18IS606 I2C-SPI bridge.

if SC18IS606
	config SC18IS606_INIT_PRIO
		int "SC18IS606 init priority"
		default 65

	config SC18IS606_CHANNEL_INIT_PRIO
		int "SC18IS606 init priority"
		default 66
endif
```

## drivers/led_strip/Kconfig
```kconfig
menuconfig LED_STRIP
    bool "LED strip drivers"
    help
        Include LED strip drivers in the system configuration.

if LED_STRIP

rsource "Kconfig.ws2812_pwm_stm32"
rsource "Kconfig.spi_rgb_led"

endif
```

## drivers/led_strip/Kconfig.spi_rgb_led
```kconfig
config SPI_RGB_LED
    bool "RGB LED strip driver using SPI"
    depends on SPI
    select LED_STRIP_RGB_SCRATCH
	help
	  Enable LED strip driver for daisy chains of SPI-ish devices.
	  2-wire SPI is supported.

config SPI_RGB_LED_DIMMING
    bool "Enable dimming support per LED"
    depends on SPI_RGB_LED
    help
      Enable dimming support for SPI RGB LED strips.
```

## drivers/led_strip/Kconfig.ws2812_pwm_stm32
```kconfig
config WS2812_PWM_STM32
    bool "WS2812 LED strip driver using PWM + DMA for STM32"
    depends on DMA_STM32
```

## drivers/mux_gpio/Kconfig
```kconfig
# I2C_MUX_GPIO gpio-based I2C bus multiplexer

config I2C_MUX_GPIO
    bool "I2C_MUX_GPIO gpio-based I2C bus multiplexer"
    depends on I2C
    help
        Enable driver for GPIO-based I2C bus multiplexer.

if I2C_MUX_GPIO
	config I2C_MUX_GPIO_INIT_PRIO
		int "I2C_MUX_GPIO init priority"
		default 65

	config I2C_MUX_GPIO_CHANNEL_INIT_PRIO
		int "I2C_MUX_GPIO init priority"
		default 66

    config I2C_MUX_GLOBAL_LOCK
        bool "If enabled a global lock will be used for the I2C mux. If disabled each instance will use its own lock."
        default n
        help
            This option should be enabled if multiple instances of this driver are using the same i2c-parent bus and
            child nodes of the different driver instances are connected to I2C devices with the same I2C address. In this
            case the global lock ensures that only one thread can get access to the I2C multiplexers at the same time.
            Without enabling this global lock it could happen that one thread switches an I2C multiplexer but before
            starting its I2C transfers another thread is scheduled. Now, this second thread could access the i2c-mux-gpio
            driver and switches another I2C multiplexer (with the same i2c-parent) as well. If both multiplexers switched
            I2C devices with the same address to the i2c-parent bus, then the data in the following I2C transfers will
            probably be corrupted.
endif

config SPI_MUX_GPIO
	bool "GPIO based SPI bus multiplexer"
	depends on SPI
	help
		Enable driver for GPIO-based SPI bus multiplexer.

if SPI_MUX_GPIO
	config SPI_MUX_GPIO_INIT_PRIO
		int "I2C_MUX_GPIO init priority"
		default 65

	config SPI_MUX_GPIO_CHANNEL_INIT_PRIO
		int "I2C_MUX_GPIO init priority"
		default 66
endif
```
