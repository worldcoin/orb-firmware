## dts/bindings/sensor/invensense,icm40627.yaml
```yaml
# Copyright (c) 2024 Intel Corporation
# Copyright (c) 2022 Esco Medical ApS
# Copyright (c) 2020 TDK Invensense
# SPDX-License-Identifier: Apache-2.0

description: |
  ICM-40627 motion tracking device
  When setting the accel-pm, accel-range, accel-odr, gyro-pm, gyro-range,
  gyro-odr properties in a .dts or .dtsi file you may include icm40627.h
  and use the macros defined there.

  Example:
  #include <zephyr/dt-bindings/sensor/icm40627.h>

  icm40627: icm40627@0 {
    ...

    accel-pwr-mode = <ICM40627_ACCEL_LN>;
    accel-fs = <ICM40627_ACCEL_FS_16G>;
    accel-odr = <ICM40627_ACCEL_ODR_2000>;
    gyro-pwr-mode= <ICM40627_GYRO_LN>;
    gyro-fs = <ICM40627_GYRO_FS_2000>;
    gyro-odr = <ICM40627_GYRO_ODR_2000>;
  };
compatible: "invensense,icm40627"
include: [sensor-device.yaml, i2c-device.yaml]

properties:
  int-gpios:
    type: phandle-array
    description: |
      The INT signal default configuration is active-high. The
      property value should ensure the flags properly describe the
      signal that is presented to the driver.

  accel-pwr-mode:
    type: int
    default: 0
    description: |
      Specify the default accelerometer power mode.
      Default is power-up configuration.
    enum:
      - 0 # ICM40627_DT_ACCEL_OFF
      - 2 # ICM40627_DT_ACCEL_LP
      - 3 # ICM40627_DT_ACCEL_LN

  accel-odr:
    type: int
    default: 6
    description: |
      Specify the default accelerometer output data rate expressed in samples per second (Hz).
      Default is power-up configuration.
    enum:
      - 1 # ICM40627_DT_ACCEL_ODR_32000
      - 2 # ICM40627_DT_ACCEL_ODR_16000
      - 3 # ICM40627_DT_ACCEL_ODR_8000
      - 4 # ICM40627_DT_ACCEL_ODR_4000
      - 5 # ICM40627_DT_ACCEL_ODR_2000
      - 6 # ICM40627_DT_ACCEL_ODR_1000
      - 7 # ICM40627_DT_ACCEL_ODR_200
      - 8 # ICM40627_DT_ACCEL_ODR_100
      - 9 # ICM40627_DT_ACCEL_ODR_50
      - 10 # ICM40627_DT_ACCEL_ODR_25
      - 11 # ICM40627_DT_ACCEL_ODR_12_5
      - 12 # ICM40627_DT_ACCEL_ODR_6_25
      - 13 # ICM40627_DT_ACCEL_ODR_3_125
      - 14 # ICM40627_DT_ACCEL_ODR_1_5625
      - 15 # ICM40627_DT_ACCEL_ODR_500

  accel-fs:
    type: int
    default: 0
    description: |
      Specify the accelerometer range in g.
      Default is power-up configuration.
    enum:
      - 0 # ICM40627_DT_ACCEL_FS_16
      - 1 # ICM40627_DT_ACCEL_FS_8
      - 2 # ICM40627_DT_ACCEL_FS_4
      - 3 # ICM40627_DT_ACCEL_FS_2

  gyro-pwr-mode:
    type: int
    default: 0
    description: |
      Specify the default gyro power mode.
      Default is power-up configuration.
    enum:
      - 0 # ICM40627_DT_GYRO_OFF
      - 1 # ICM40627_DT_GYRO_STANDBY
      - 3 # ICM40627_DT_GYRO_LN

  gyro-odr:
    type: int
    default: 6
    description: |
      Specify the default gyro output data rate expressed in samples per second (Hz).
      Default is power-up configuration.
    enum:
      - 1 # ICM40627_DT_GYRO_ODR_32000
      - 2 # ICM40627_DT_GYRO_ODR_16000
      - 3 # ICM40627_DT_GYRO_ODR_8000
      - 4 # ICM40627_DT_GYRO_ODR_4000
      - 5 # ICM40627_DT_GYRO_ODR_2000
      - 6 # ICM40627_DT_GYRO_ODR_1000
      - 7 # ICM40627_DT_GYRO_ODR_200
      - 8 # ICM40627_DT_GYRO_ODR_100
      - 9 # ICM40627_DT_GYRO_ODR_50
      - 10 # ICM40627_DT_GYRO_ODR_25
      - 11 # ICM40627_DT_GYRO_ODR_12_5
      - 15 # ICM40627_DT_GYRO_ODR_500

  gyro-fs:
    type: int
    default: 0
    description: |
      Specify the gyro range in degrees per second.
      Default is power-up configuration.
    enum:
      - 0 # ICM40627_DT_GYRO_FS_2000
      - 1 # ICM40627_DT_GYRO_FS_1000
      - 2 # ICM40627_DT_GYRO_FS_500
      - 3 # ICM40627_DT_GYRO_FS_250
      - 4 # ICM40627_DT_GYRO_FS_125
      - 5 # ICM40627_DT_GYRO_FS_62_5
      - 6 # ICM40627_DT_GYRO_FS_31_25
      - 7 # ICM40627_DT_GYRO_FS_15_625
```

## dts/bindings/spi/ti,drv8434s.yaml
```yaml
# Copyright (c) 2025 Tools for Humanity GmbH
# SPDX-License-Identifier: Apache-2.0

description: |
  TI DRV8434S stepper motor driver.
  This is an SPI-controlled stepper motor driver with direction and enable control pins.

compatible: "ti,drv8434s"

include:
  - name: spi-device.yaml
  - name: stepper-controller.yaml
    property-allowlist:
      - micro-step-res
      - dir-gpios
      - en-gpios

properties:
  spi-cs-gpios:
    type: phandle-array
    required: false
    description: |
      GPIO pin for software-controlled SPI chip select.
      This is used when the CS is directly controlled via a GPIO expander.
```

## dts/bindings/spi/tmc,5041-spi.yaml
```yaml
description: "TMC 5041 motion controller"

include: spi-device.yaml

compatible: "tmc,5041-spi"
```

## dts/bindings/tfh/tfh,board-version.yaml
```yaml
# Copyright (c) 2023 Tools for Humanity GmbH
# SPDX-License-Identifier: Apache-2.0

description: |
  Description for a voltage divider that allows to get the hardware version of the board.

compatible: "tfh,board-version"

properties:
  io-channels:
    type: phandle-array
    required: true
    description: |
      Channel to use to read the voltage divider output.
```

## dts/bindings/tfh/tfh,liquid-lens.yaml
```yaml
# Copyright (c) 2023 Tools for Humanity GmbH
# SPDX-License-Identifier: Apache-2.0

description: |
  Liquid lens driver using STM32 HRTIM for H-bridge control with current
  feedback via ADC. The driver uses a PI controller to regulate the lens
  current based on ADC measurements from a current sense amplifier.

compatible: "tfh,liquid-lens"

include: [base.yaml, pinctrl-device.yaml]

properties:
  hrtim:
    type: phandle
    required: true
    description: |
      Reference to the HRTIM peripheral used for H-bridge PWM control.

  io-channels:
    type: phandle-array
    required: true
    description: |
      ADC channels for reading the current going through the liquid lens.
      Expected channels in order:
        - INA240 reference voltage
        - INA240 signal voltage
        - Internal voltage reference (VREFINT)

  io-channel-names:
    type: string-array
    required: true
    description: |
      Names of the ADC channels for reading the current.
      Expected names: "ina240_ref", "ina240_sig", "vrefint"

  enable-gpios:
    type: phandle-array
    required: true
    description: |
      GPIO pin to enable liquid lens gate drivers (H-bridge enable)

  amplifier-gains:
    type: array
    required: true
    description: |
      Gain of the current sense amplifier (INA240) in the measurement circuit.
      On Pearl, this is an array with values for different hardware versions.
      On Diamond, this is a single-element array.

  shunt-resistor-ohms:
    type: string-array
    required: true
    description: |
      Shunt resistor value in Ohms used for current sensing.
      Stored as string to preserve floating-point precision.
      On Pearl, this is an array with values for different hardware versions.
      On Diamond, this is a single-element array.

  pinctrl-0:
    required: true
    description: |
      Pin control configuration for HRTIM output pins.
      Should include pins for both H-bridge legs (HA1, HA2, HB1, HB2).

  pinctrl-names:
    required: true
```
