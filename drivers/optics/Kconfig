## drivers/optics/Kconfig
```kconfig
# Copyright (c) 2023 Tools for Humanity GmbH
# SPDX-License-Identifier: Apache-2.0

rsource "liquid_lens/Kconfig"
```

## drivers/optics/liquid_lens/Kconfig
```kconfig
# Copyright (c) 2023 Tools for Humanity GmbH
# SPDX-License-Identifier: Apache-2.0

menuconfig LIQUID_LENS
	bool "Liquid lens driver"
	default y
	depends on DT_HAS_TFH_LIQUID_LENS_ENABLED
	depends on ADC
	depends on GPIO
	select PINCTRL
	help
	  Enable the liquid lens driver which controls the lens current
	  using STM32 HRTIM PWM with current feedback via ADC.

if LIQUID_LENS

module = LIQUID_LENS
module-str = liquid_lens
source "subsys/logging/Kconfig.template.log_config"

config LIQUID_LENS_INIT_PRIORITY
	int "Liquid lens initialization priority"
	default 90
	help
	  Initialization priority for the liquid lens driver.
	  Should be after ADC and GPIO drivers are initialized.

config LIQUID_LENS_THREAD_STACK_SIZE
	int "Stack size for liquid lens control thread"
	default 1024
	help
	  Stack size for the liquid lens ADC sampling and control thread.

config LIQUID_LENS_THREAD_PRIORITY
	int "Thread priority for liquid lens control"
	default 5
	help
	  Priority for the liquid lens ADC sampling and control thread.

endif # LIQUID_LENS
```

## drivers/regulator/Kconfig
```kconfig
config LM51XX_REGULATOR
	bool "LM51xx boost converter regulator driver"
	default y
	depends on DT_HAS_TFH_LM51XX_ENABLED
	depends on GPIO
	depends on REGULATOR
	help
	  Enable the driver for LM51xx-family boost converters
	  (LM5176, LM5144, etc.) controlled via an enable GPIO
	  and an optional mode GPIO.

if LM51XX_REGULATOR

config LM51XX_REGULATOR_INIT_PRIORITY
	int "Init priority"
	default 49
	help
	  Device driver initialization priority.
	  Must be after GPIO expander init on Diamond (PCA95xx = 48).

endif # LM51XX_REGULATOR
```

## drivers/sensor/Kconfig
```kconfig
menuconfig SENSOR
    bool "Sensor Drivers"
    help
        Include sensor drivers in system config

if SENSOR

rsource "bu27030/Kconfig"

endif
```

## drivers/sensor/bu27030/Kconfig
```kconfig
# BU27030 ambient light sensor configuration options

config BU27030
    bool "BU27030 ambient light sensor"
    depends on I2C
    help
        Enable driver for BU27030 I2C-based ambient light sensor.
```

## drivers/sensor/icm40627/Kconfig
```kconfig
# ICM40627-P Six-Axis Motion Tracking device configuration options
#
# Copyright (c) 2022 Intel Corporation
#
# SPDX-License-Identifier: Apache-2.0

config ICM40627
	bool "ICM40627 Six-Axis Motion Tracking Device"
	default y
	depends on DT_HAS_INVENSENSE_ICM40627_ENABLED
	select I2C
	help
	  Enable driver for ICM40627 I2C-based six-axis motion tracking device.

config EMUL_ICM40627
	bool "Emulator for the ICM40627"
	default y
	depends on ICM40627
	depends on EMUL
	help
	  Enable the hardware emulator for the ICM40627. Doing so allows exercising
	  sensor APIs for this IMU in native_posix and qemu.

if ICM40627

choice
	prompt "Trigger mode"
	default ICM40627_TRIGGER_GLOBAL_THREAD
	help
	  Specify the type of triggering to be used by the driver

config ICM40627_TRIGGER_NONE
	bool "No trigger"

config ICM40627_TRIGGER_GLOBAL_THREAD
	bool "Use global thread"
	select ICM40627_TRIGGER

config ICM40627_TRIGGER_OWN_THREAD
	bool "Use own thread"
	select ICM40627_TRIGGER

endchoice

config ICM40627_TRIGGER
	bool

config ICM40627_THREAD_PRIORITY
	int "Own thread priority"
	depends on ICM40627_TRIGGER_OWN_THREAD
	default 10
	help
	  The priority of the thread used for handling interrupts.

config ICM40627_THREAD_STACK_SIZE
	int "Own thread stack size"
	depends on ICM40627_TRIGGER_OWN_THREAD
	default 1024
	help
	  The thread stack size.

endif # ICM40627
```

## drivers/sensor/vl53l1x/Kconfig
```kconfig
# VL53L1X time of flight sensor configuration options

config VL53L1X
    bool "VL53L1X time of flight sensor"
    depends on I2C
    select HAS_STLIB
    help
        Enable driver for VL53L1X I2C-based time of flight sensor.

if VL53L1X

config VL53L1X_INTER_MEASUREMENT_PERIOD
    int "Inter-measurement period in milliseconds"
    default 1000
    help
        Default inter-measurement period set during driver initialization

config VL53L1X_PROXIMITY_THRESHOLD
    int "Proximity threshold in millimeters"
    default 100
    help
        Threshold used for proximity detection when sensor is used with SENSOR_CHAN_PROX.

endif
```

## drivers/vl53l1x/Kconfig
```kconfig
# VL53L1X time of flight sensor configuration options

menuconfig VL53L1X
	bool "VL53L1X time of flight sensor"
	depends on I2C
	select HAS_STLIB
	help
	  Enable driver for VL53L1X I2C-based time of flight sensor.

config VL53L1X_PROXIMITY_THRESHOLD
	int "Proximity threshold in millimeters"
	default 100
	depends on VL53L1X
	help
	  Threshold used for proximity detection when sensor is used with SENSOR_CHAN_PROX.
```

## dts/bindings/gpio/gpio-level-shift-en.yaml
```yaml
---
description: GPIO pin to enable 3.3V to 1.8V level shifter

compatible: "gpio-level-shift-en"

properties:
  gpios:
    type: phandle-array
    required: true
```

## dts/bindings/gpio/gpio-liquid-lens-en.yaml
```yaml
---
description: GPIO pin to enable liquid lens gate drivers

compatible: "gpio-liquid-lens-en"

properties:
  gpios:
    type: phandle-array
    required: true
```

## dts/bindings/gpio/gpio-lte-gps-usb.yaml
```yaml
---
description: GPIO pin to reset the LTE, GPS, and USB modules

compatible: "gpio-lte-gps-usb"

properties:
    gpios:
        type: phandle-array
        required: true
```

## dts/bindings/gpio/gpio-power-good.yaml
```yaml
---
description: GPIO pin attached to a power good pin for a power regulator

compatible: "gpio-power-good"

properties:
    gpios:
        type: phandle-array
        required: true
```

## dts/bindings/i2c_mux_gpio/tfh,i2c-mux-gpio.yaml
```yaml
description: |
  GPIO-based I2C bus multiplexer
                                    +-----+  +-----+
                                    | dev |  | dev |
   +---------------+                +-----+  +-----+
   | SoC           |                   |        |
   |               |          /--------+--------+
   |   +---------+ |  +------+    child bus @ 0x0, on GPIO values set to 0b00
   |   | I2C root|-|--| Mux  |
   |   +---------+ |  +--+---+    child bus @ 0x3, on GPIO values set to 0b11
   |               |     |    \----------+--------+--------+
   |     +-------+ |     |               |        |        |
   |     | GPIOs |-|-----+            +-----+  +-----+  +-----+
   |     +-------+ |  @ channel       | dev |  | dev |  | dev |
   +---------------+                  +-----+  +-----+  +-----+

  An example IC for realising the Mux in hardware is the TMUX1209 from Texas Instruments.

  Required properties:
  - compatible: "tfh,i2c-mux-gpio"
  - i2c-parent: The phandle of the I2C bus that this multiplexer's master-side port is connected to.
  - mux-gpios: List of gpios used to control the muxer. The first gpio in this list corresponds to the least
               significant bit in the child bus address.
  * I2C child bus nodes.

  Example:
    i2c-mux-gpio {
      compatible = "tfh,i2c-mux-gpio";
      status = "okay";
      #address-cells = <1>;
      #size-cells = <0>;
      mux-gpios = <&gpioe 4 GPIO_ACTIVE_HIGH>, <&gpioe 5 GPIO_ACTIVE_HIGH>;
      enable-gpios = <&gpiob 1 GPIO_ACTIVE_HIGH>;
      i2c-parent = <&i2c1>;

      mux_i2c@0 {
          compatible = "tfh,i2c-mux-gpio-channel";
          status = "okay";
          reg = <0>;
          #address-cells = <1>;
          #size-cells = <0>;

          temp_sensor_1: tmp112@49 {
            compatible = "ti,tmp112";
            status = "okay";
            reg = <0x49>;
          };

      };

      mux_i2c@3 {
        compatible = "tfh,i2c-mux-gpio-channel";
        status = "okay";
        reg = <3>;
        #address-cells = <1>;
        #size-cells = <0>;

        temp_sensor_2: tmp112@49 {
          compatible = "ti,tmp112";
          status = "okay";
          reg = <0x49>;
        };
      };
    };

compatible: "tfh,i2c-mux-gpio"

properties:
  mux-gpios:
    type: phandle-array
    required: true
  enable-gpios:
    type: phandle-array
    required: false
  i2c-parent:
    type: phandle
    required: true

child-binding:
  description: I2C switch channel node
  compatible: "tfh,i2c-mux-gpio-channel"
  include: [i2c-controller.yaml]
```

## dts/bindings/i2c_spi_bridge/nxp,sc18is606.yaml
```yaml
description: |
  I2C-bus to SPI bridge

  Required properties:
  - compatible: "nxp,sc18is606"
  - reg: I2C address of SC18IS606
  * SPI child bus node

  Example:
  &i2c4 {
    pinctrl-0 = <&i2c4_scl_pc6 &i2c4_sda_pb7>;
    pinctrl-names = "default";
    status = "okay";

    spi_bridge: sc18is606@28{
      reg = <0x28>;
      compatible = "nxp,sc18is606";
      status = "okay";
      #address-cells = <1>;
      #size-cells = <0>;

      bridge_spi_bus: spi@0{
        compatible = "nxp,sc18is606-spi-master";
        status = "okay";
        reg = <0>;
        #address-cells = <1>;
        #size-cells = <0>;
        clock-frequency = <455000>;

        rgb_leds:rgb_leds@0{
          compatible = "we,spi-rgb-led";
          reg = <0>;
          spi-max-frequency = <455000>;
          duplex = <SPI_HALF_DUPLEX>;
          num-leds = <64>;
        };
      };
    };
  };

compatible: "nxp,sc18is606"

include: [i2c-device.yaml]

properties:
  reset-gpios:
    type: phandle-array
    description: |
      GPIO connected to the controller RESET pin. This pin is active-low.

child-binding:
  description: SPI controller
  compatible: "nxp,sc18is606-spi-master"
  include: [spi-controller.yaml]
```

## dts/bindings/led_strip/we,spi-rgb-led.yaml
```yaml
description: |
  SPI-based LED strip controller
  We expect this node to be a child of a SPI node

  led_strip:led_strip@0
  {
      compatible = "we,spi-rgb-led";
      reg = <0>;
      spi-max-frequency = <1600000>;
      duplex = <SPI_HALF_DUPLEX>;

      num-leds = <5>;
  };

include: spi-device.yaml

compatible: "we,spi-rgb-led"

properties:
  num-leds:
    type: int
    required: true
    description: Number of LEDs in LED strip
```

## dts/bindings/led_strip/worldsemi,ws2812-pwm-stm32.yaml
```yaml
description: |
  STM32 PWM-based WS2812 LED strip controller
  We expect this node to be a child of a timer node

compatible: "worldsemi,ws2812-pwm-stm32"

include: [base.yaml, pinctrl-device.yaml]

properties:
  timer-channel:
    type: int
    required: true
    description: PWM timer output channel

  dmas:
    type: phandle-array
    required: true
    description: |
      DMA specifier with channel, slot (DMAMUX request), and config.
      Example: dmas = <&dmamux1 1 46 (STM32_DMA_PERIPH_TX | STM32_DMA_PERIPH_16BITS | STM32_DMA_PRIORITY_HIGH)>;

  dma-names:
    type: string-array
    required: true
    description: DMA channel name, must be "tx"

  num-leds:
    type: int
    required: true
    description: Number of LEDs in LED strip
```

## dts/bindings/misc/ti,bq4050.yaml
```yaml
description: BQ4050 battery gas gauge and protection

compatible: "ti,bq4050"

include: i2c-device.yaml
```

## dts/bindings/polarizer_step/pwm-polarizer-step.yaml
```yaml
description: PWM for polarizer step

compatible: "pwm-polarizer-step"

include: [base.yaml]

properties:
  pwms:
    required: true
    type: phandle-array
```

## dts/bindings/rechargeable_battery/rechargeable-battery.yaml
```yaml
---
description: Pins allowing management of a rechargeable battery

compatible: "rechargeable-battery"

properties:
  charge-enable-gpios:
    type: phandle-array
    required: true
    description: Enable charging of the battery
  is-charging-gpios:
    type: phandle-array
    required: true
    description: Battery is currently charging
  is-fully-charged-gpios:
    type: phandle-array
    required: false
    description: Battery is fully charged
  power-input-enabled-gpios:
    type: phandle-array
    required: false
    description: Power input is available to charge the battery
  bat-meas-enable-gpios:
    type: phandle-array
    required: false
    description: Enable circuitry for battery voltage measurement
  io-channels:
    type: phandle-array
    required: false
    description: ADC conversion channels for battery voltage and battery NTC (temperature)
  io-channel-names:
    required: false
    type: string-array
    description: ADC conversion channel names ("battery_voltage" or "battery_ntc")
```

## dts/bindings/regulator/tfh,lm51xx.yaml
```yaml
# Copyright (c) 2025 Tools for Humanity Corporation
# SPDX-License-Identifier: Apache-2.0

description: |
  LM51xx-family boost converter (LM5176, LM5144, etc.) controlled via
  an enable GPIO and an optional mode GPIO.

  Unlike regulator-fixed, this driver configures GPIOs as
  GPIO_OUTPUT_INACTIVE at init so PCA95xx expanders (whose output
  register defaults to all-1s) do not briefly enable the converter
  at boot.

  The optional mode-gpios pin (FPWM / diode-emulation select) is
  initialised to inactive (diode-emulation) and may be toggled at
  runtime by other subsystems via its gpio_dt_spec.

include:
  - name: base.yaml
  - name: regulator.yaml
    property-allowlist:
      - regulator-name
      - regulator-boot-on
      - regulator-always-on

compatible: "tfh,lm51xx"

properties:
  regulator-name:
    required: true

  enable-gpios:
    type: phandle-array
    required: true
    description: GPIO to enable/disable the converter.

  mode-gpios:
    type: phandle-array
    description: |
      Optional GPIO for FPWM / diode-emulation mode select.
      Configured as GPIO_OUTPUT_INACTIVE at init (diode-emulation).
      May be toggled at runtime by other subsystems.
```
