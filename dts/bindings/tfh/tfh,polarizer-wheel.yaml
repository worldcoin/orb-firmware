## dts/bindings/tfh/tfh,polarizer-wheel.yaml
```yaml
# Copyright (c) 2025 Tools for Humanity GmbH
# SPDX-License-Identifier: Apache-2.0

description: |
  Polarizer wheel assembly with encoder feedback.
  This node should be a child of a ti,drv8434s motor driver node.

compatible: "tfh,polarizer-wheel"

properties:
  encoder-enable-gpios:
    type: phandle-array
    required: true
    description: |
      GPIO pin to enable the encoder.

  encoder-gpios:
    type: phandle-array
    required: true
    description: |
      GPIO pin for encoder signal input.
```

## dts/bindings/tfh/tfh,stm32-pwm.yaml
```yaml
description: STM32 PWM, but tfh vendor, as to not invoke the stm32 driver

compatible: "tfh,stm32-pwm"

properties:
  pinctrl-0:
    type: phandles
    required: true
  pinctrl-names:
    type: string
    required: false
  channels:
    type: array
    required: false
```

## dts/bindings/timer/st,stm32-hr-timers.yaml
```yaml
description: STM32 HR timers

compatible: "st,stm32-hr-timers"

include: base.yaml

properties:
    reg:
        required: true

    clocks:
        required: true
```

## dts/bindings/white_leds/pwm-white-leds.yaml
```yaml
description: PWM for white LEDs on Front Unit

compatible: "pwm-white-leds"

include: [base.yaml]

properties:
  pwms:
    required: true
    type: phandle-array
```

## dts/bindings/worldcoin/worldcoin,liquid-lens.yaml
```yaml
# Copyright (c) 2023 Tools for Humanity GmbH
# SPDX-License-Identifier: Apache-2.0

description: |
  Description for the liquid lens

compatible: "worldcoin,liquid-lens"

properties:
  io-channels:
    type: phandle-array
    required: true
    description: |
      Channels for reading the current going through the liquid lens
  io-channel-names:
    type: string-array
    required: true
    description: |
      Names of the channels for reading the current going through the liquid lens
  enable-gpios:
    type: phandle-array
    required: true
    description: |
      GPIO pin to enable liquid lens gate drivers
  amplifier-gains:
    type: array
    required: true
    description: |
      Gain of the amplifier in the current measurement circuit
  shunt-resistor-ohms:
    type: string-array
    required: true
    description: |
      Shunt resistor value in Ohms
```

## dts/bindings/worldcoin/worldcoin,stm32-pwm.yaml
```yaml
description: STM32 PWM, but worldcoin as to not invoke the stm32 driver

compatible: "worldcoin,stm32-pwm"

properties:
    pinctrl-0:
        type: phandles
        required: true
```

## dts/bindings/worldcoin/worldcoin,voltage-measurement.yaml
```yaml
# Copyright (c) 2023 Tools for Humanity GmbH
# SPDX-License-Identifier: Apache-2.0

description: |
  Description for voltage measurement circuits.

compatible: "worldcoin,voltage-measurement"

properties:
  io-channels:
    type: phandle-array
    required: true
    description: |
      Channels to use to read the voltages.
  io-channel-names:
    type: string-array
    description: |
      Channel names.
  supply-voltages-meas-enable-gpios:
    type: phandle-array
    required: true
    description: |
      GPIO for enabling the measurement circuits.
  voltage-divider-scalings:
    type: string-array
    required: true
    description: |
      Factors for calculating the supply rail voltage from the voltage at the ADC pin.
```

## lib/Kconfig
```kconfig
menu "Log Levels"
rsource "can_messaging/log_levels.Kconfig"
rsource "uart_messaging/log_levels.Kconfig"
rsource "dfu/log_levels.Kconfig"
rsource "health_monitoring/log_levels.Kconfig"
rsource "i2c_scan/log_levels.Kconfig"
rsource "log_backend_can/log_levels.Kconfig"
rsource "errors/log_levels.Kconfig"
rsource "storage/log_levels.Kconfig"
rsource "watchdog/log_levels.Kconfig"
endmenu

rsource "can_messaging/Kconfig"
rsource "uart_messaging/Kconfig"
rsource "log_backend_can/Kconfig"
rsource "errors/Kconfig"
rsource "dfu/Kconfig"
rsource "storage/Kconfig"
rsource "watchdog/Kconfig"
rsource "health_monitoring/Kconfig"
rsource "i2c_scan/Kconfig"
```

## lib/can_mcu_message/Kconfig
```kconfig
config ORB_LIB_CAN_MCU_MESSAGE
    bool "Enable the CAN messaging with protobuf McuMessage"
    depends on ORB_PROTOBUF_DEFINITIONS_LIB

config CAN_ADDRESS_MCU
    hex "CAN address to receive data"
    default 1
    depends on ORB_LIB_CAN_MCU_MESSAGE

config CAN_ADDRESS_DEFAULT_REMOTE
    hex "Default CAN address to send data to"
    default 0x80
    depends on ORB_LIB_CAN_MCU_MESSAGE

config ORB_LIB_THREAD_PRIORITY_CANBUS_RX
    int "CAN bus RX thread priority"
    default 5
    depends on ORB_LIB_CAN_MCU_MESSAGE

config ORB_LIB_THREAD_STACK_SIZE_CANBUS_RX
    int "Stack size for CAN RX thread"
    default 2048
    depends on ORB_LIB_CAN_MCU_MESSAGE

config ORB_LIB_THREAD_PRIORITY_CANBUS_TX
    int "CAN bus TX thread priority"
    default 5
    depends on ORB_LIB_CAN_MCU_MESSAGE

config ORB_LIB_THREAD_STACK_SIZE_CANBUS_TX
    int "Stack size for CAN TX thread"
    default 1024
    depends on ORB_LIB_CAN_MCU_MESSAGE
```

## lib/can_messaging/Kconfig
```kconfig
menuconfig ORB_LIB_CAN_MESSAGING
    bool "CAN messaging library"
    select ORB_LIB_ERRORS

if ORB_LIB_CAN_MESSAGING

config CAN_ADDRESS_MCU_TO_JETSON_TX
    hex "CAN address to send data to the Jetson"
    default 0x80

config CAN_ADDRESS_JETSON_TO_MCU_RX
    hex "CAN address to receive data from the Jetson"
    default 0x01 if (BOARD_PEARL_MAIN || BOARD_DIAMOND_MAIN)
    default 0x02 if (BOARD_PEARL_SECURITY || BOARD_DIAMOND_SECURITY)

config CAN_ADDRESS_MCU_TO_MCU_TX
    hex "CAN address to send data to other MCU"
    default 0x42 if CAN_ADDRESS_JETSON_TO_MCU_RX=0x01  # main MCU sends to 0x42
    default 0x41 if CAN_ADDRESS_JETSON_TO_MCU_RX=0x02  # sec MCU sends to 0x41

config CAN_ADDRESS_MCU_TO_MCU_RX
    hex "CAN address to receive MCU-to-MCU messages"
    default 0x41 if CAN_ADDRESS_JETSON_TO_MCU_RX=0x01  # main MCU receives on 0x41
    default 0x42 if CAN_ADDRESS_JETSON_TO_MCU_RX=0x02  # sec MCU receives on 0x42

config ORB_LIB_THREAD_PRIORITY_CANBUS_MONITOR
    int "CAN bus monitoring thread priority"
    default 5

config ORB_LIB_THREAD_STACK_SIZE_CANBUS_MONITOR
    int "Stack size for CAN monitoring thread"
    default 1024

config ORB_LIB_THREAD_PRIORITY_CANBUS_RX
    int "CAN bus RX thread priority"
    default 5

config ORB_LIB_THREAD_STACK_SIZE_CANBUS_RX
    int "Stack size for CAN RX thread"
    default 2048

config ORB_LIB_THREAD_PRIORITY_CANBUS_TX
    int "CAN bus TX thread priority"
    default 5

config ORB_LIB_THREAD_STACK_SIZE_CANBUS_TX
    int "Stack size for CAN TX thread"
    default 1024

config ORB_LIB_CANBUS_TX_QUEUE_SIZE
    int "CAN TX queue size"
    default 32

config ORB_LIB_THREAD_STACK_SIZE_CANBUS_ISOTP_RX
    int "Stack size for CAN ISO-TP RX thread"
    default 1700

config CAN_ISOTP_REMOTE_ID
    hex "4-bit ID used to build ISO-TP communication channel"
    default 0x8
    depends on ISOTP

config CAN_ISOTP_LOCAL_ID
    hex "4-bit ID used to build ISO-TP communication channel"
    default 0x1
    depends on ISOTP

config CAN_ISOTP_REMOTE_APP_COUNT
    int "Number of remote apps to bind to. Max is 7"
    range 0 7
    default 7
    depends on ISOTP

config CAN_ISOTP_MAX_SIZE_BYTES
    int "CAN ISO-TP message maximum size."
    default 1024
    range 1 4096
    depends on ISOTP
    help
        "An ISO-TP message can contain up to 4096 bytes but we might want to cap the value depending on application's constraints"

config ORB_LIB_CAN_ISOTP_TX_QUEUE_SIZE
    int "CAN TX queue size"
    default 16

config ORB_LIB_CAN_ISOTP_BLOCKSIZE
    int "ISO-TP block size, which is number of frames between each control flow frame"
    default 8

endif
```

## lib/date/Kconfig
```kconfig
config ORB_LIB_DATE
    bool "Date/clock library"
    depends on RTC

if ORB_LIB_DATE

endif
```

## lib/dfu/Kconfig
```kconfig
config ORB_LIB_DFU
    bool "Device firmware upgrade library"

if ORB_LIB_DFU

config ORB_LIB_THREAD_PRIORITY_DFU
    int "Block processing thread priority, including Flash operations"
    default 10

config ORB_LIB_THREAD_STACK_SIZE_DFU
    int "Stack size for block processing thread"
    default 1024

endif
```

## lib/errors/Kconfig
```kconfig
config ORB_LIB_ERRORS
    bool "Custom Orb errors library"
    select ORB_LIB_WATCHDOG

if ORB_LIB_ERRORS

config ORB_LIB_ERRORS_APP_ASSERT
    bool "Use assertions"
    default y
    help
        Enable assertions. Hard assertions are for fatal errors and make the system reset. Soft assertions are for recoverable errors.

config ORB_LIB_ERRORS_TESTS
    bool "Provide fatal errors examples"
    select TEST
    select IRQ_OFFLOAD
    select ASSERT
    depends on ORB_LIB_ERRORS_APP_ASSERT
    help
        Allows for testing fatal errors and assert

endif
```

## lib/health_monitoring/Kconfig
```kconfig
config ORB_LIB_HEALTH_MONITORING
    bool "Health monitoring"

config ORB_LIB_THREAD_STACK_SIZE_HEARTBEAT
    int "Heartbeat thread stack size"
    default 512
    help
        "Tweak depending on the heartbeat timeout handler"

config ORB_LIB_SYS_INIT_STATE_PRIORITY
    int "post-kernel init priority for orb state module"
    default 50
```

## lib/log_backend_can/Kconfig
```kconfig
config ORB_LIB_LOG_BACKEND_CAN
    default y
    bool "Send logs over the CAN bus"
    select LOG_OUTPUT
	depends on LOG

config ORB_LIB_LOG_BACKEND_LEVEL
	int "CAN backend log level"
	default 2
	range 0 4
	help
	  Sets log level for CAN backend. When
	  set to 0 it means log will not be activated.
	  Levels are:

	  - 0 OFF, do not write
	  - 1 ERROR, only write LOG_LEVEL_ERR
	  - 2 WARNING, write LOG_LEVEL_WRN
	  - 3 INFO, write LOG_LEVEL_INFO
	  - 4 DEBUG, write LOG_LEVEL_DBG
```

## lib/storage/Kconfig
```kconfig
config ORB_LIB_STORAGE
    bool "Storage library"

if ORB_LIB_STORAGE

config ORB_LIB_STORAGE_TESTS
    bool "Include storage tests"

endif
```

## lib/uart_messaging/Kconfig
```kconfig
menuconfig ORB_LIB_UART_MESSAGING
    bool "UART messaging library"
    select ORB_LIB_ERRORS

if ORB_LIB_UART_MESSAGING

config ORB_LIB_UART_RX_BUF_SIZE_BYTES
    int "RX buffer size (power of 2)"
    default 2048
    help
        Least amount of bytes needed to receive the biggest message while some other bytes might be received in the
        background. It is advised to allocate at least twice the size of the biggest UART message.

config ORB_LIB_THREAD_PRIORITY_UART_RX
    int "UART RX thread priority"
    default 5

config ORB_LIB_THREAD_STACK_SIZE_UART_RX
    int "Stack size for UART RX thread"
    default 2048

endif
```

## lib/watchdog/Kconfig
```kconfig
config ORB_LIB_WATCHDOG
    bool "Watchdog library"
    select WDT_DISABLE_AT_BOOT
    depends on WATCHDOG

if ORB_LIB_WATCHDOG

config ORB_LIB_WATCHDOG_SYS_INIT
    bool "Initialize watchdog in sys_init, when disabled (default) `watchdog_init()` must be explicitly called"
    default n

if ORB_LIB_WATCHDOG_SYS_INIT

config ORB_LIB_WATCHDOG_INIT_PRIORITY
    int "Watchdog initialization priority"
    default 51 # KERNEL_INIT_PRIORITY_DEVICE + 1

endif

config ORB_LIB_THREAD_PRIORITY_WATCHDOG
    int "Watchdog thread priority"
    default 10

config ORB_LIB_THREAD_STACK_SIZE_WATCHDOG
    int "Stack size for the watchdog thread"
    default 512

config ORB_LIB_WATCHDOG_TIMEOUT_MS
	int "Watchdog timeout"
	default 1000

config ORB_LIB_WATCHDOG_RELOAD_MS
	int "Watchdog reload interval"
	default 200

config ORB_LIB_WATCHDOG_TESTS
    bool "Include watchdog tests"

endif
```

## main_board/app/testcase.yaml
```yaml
tests:
  orb.hil:
    extra_args:
      - OVERLAY_CONFIG=tests.conf
      - DTC_OVERLAY_FILE=one_slot.overlay
    platform_allow:
      - pearl_main
      - diamond_main
    timeout: 480
```
