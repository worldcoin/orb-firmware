## CMakeLists.txt
```
cmake_minimum_required(VERSION 3.20.0)
set(TARGET app)

get_filename_component(PROJECT_DIR ${CMAKE_CURRENT_SOURCE_DIR}/../../ ABSOLUTE)
get_filename_component(WORKSPACE_DIR ${PROJECT_DIR} DIRECTORY)

set(APP_FILES_COMPILE_OPTIONS -Wextra)
if ("${CMAKE_BUILD_TYPE}" STREQUAL "Release")
    message(STATUS "Building ${CMAKE_BUILD_TYPE}: optimized ⚡️")

    # Add configuration file to overwrite debug configuration
    list(APPEND OVERLAY_CONFIG "release.conf")
else ()
    message(STATUS "Building default: debug info included")
    add_compile_definitions(DEBUG)

    list(APPEND OVERLAY_CONFIG "debug.conf")
endif ()

# Generate version for the current project
# CMake will re-run if file "VERSION" changes
include(${PROJECT_DIR}/utils/cmake/version.cmake)
application_version(APP_VERSION)
message(STATUS "Application version: ${APP_VERSION}")
set_property(
    DIRECTORY
    APPEND
    PROPERTY CMAKE_CONFIGURE_DEPENDS ${PROJECT_DIR}/VERSION
)

set_property(GLOBAL PROPERTY CSTD gnu11)

# default board is orb
if (DEFINED ENV{BOARD})
    set(BOARD $ENV{BOARD})
else ()
    set(BOARD pearl_main)
endif ()

# Get our custom boards definitions before loading Zephyr
list(APPEND BOARD_ROOT ${PROJECT_DIR})
list(APPEND DTS_ROOT ${PROJECT_DIR})

# Add a common dts overlay necessary to ensure the app is linked into,
# and fits inside, the slot0 partition. (If the user specified a
# DTC_OVERLAY_FILE on the CMake command line, we need to append onto
# the list).
if (DTC_OVERLAY_FILE)
    set(DTC_OVERLAY_FILE
        "${DTC_OVERLAY_FILE} ${CMAKE_CURRENT_LIST_DIR}/dts.overlay"
        CACHE STRING "" FORCE
        )
else ()
    set(DTC_OVERLAY_FILE dts.overlay)
endif ()

# In case we don't use West to build, add our local modules to the list
list(APPEND ZEPHYR_EXTRA_MODULES ${PROJECT_DIR})

find_package(Zephyr REQUIRED HINTS $ENV{ZEPHYR_BASE})
project(orb-mcu-main-app)

# SINE_TABLE_LENGTH defined for values from 0 to pi/2 (0..1)
set(SINE_TABLE_LENGTH 150)
add_compile_definitions(SINE_TABLE_LENGTH=${SINE_TABLE_LENGTH})
set(SINE_LUT_SRC_FILE ${CMAKE_BINARY_DIR}/zephyr/sine_lut.c)
add_custom_command(OUTPUT ${SINE_LUT_SRC_FILE}
    COMMAND python3 ${PROJECT_DIR}/utils/math/generate_half_sine.py ${SINE_TABLE_LENGTH} > ${SINE_LUT_SRC_FILE})

set(SOURCES_FILES)
# common source files
list(APPEND SOURCES_FILES
    src/main.c

    src/optics/optics.c
    src/optics/1d_tof/tof_1d.c
    src/optics/ir_camera_system/ir_camera_timer_settings.c
    src/optics/ir_camera_system/ir_camera_system_hw.c
    src/optics/ir_camera_system/ir_camera_system.c
    src/optics/liquid_lens/liquid_lens.c
    src/optics/mirror/mirror.c

    src/power/boot/boot.c

    src/runner/runner.c

    src/system/diag.c
    src/system/logs.c
    src/system/version/version.c
    src/system/stm32_timer_utils/stm32_timer_utils.c

    src/temperature/sensors/temperature.c
    src/temperature/fan/fan.c
    src/temperature/fan/fan_tach.c

    src/voltage_measurement/voltage_measurement.c

    ${SINE_LUT_SRC_FILE}
    src/ui/ui.c
    src/ui/ambient_light/als.c
    src/ui/button/button.c
    src/ui/rgb_leds/rgb_leds.c
    src/ui/rgb_leds/front_leds/front_leds.c
    src/ui/rgb_leds/operator_leds/operator_leds.c
    src/ui/sound/sound.c
    )

if (CONFIG_BOARD_PEARL_MAIN)
    list(APPEND SOURCES_FILES src/gnss/gnss.c)
    list(APPEND SOURCES_FILES src/power/battery/battery_ruby.c)
endif()

if (CONFIG_BOARD_DIAMOND_MAIN)
    list(APPEND SOURCES_FILES src/power/battery/battery_amber.c)
    list(APPEND SOURCES_FILES src/ui/rgb_leds/cone_leds/cone_leds.c)
    list(APPEND SOURCES_FILES src/ui/white_leds/white_leds.c)
    list(APPEND SOURCES_FILES src/power/battery/battery_amber.c)
endif()

if (CONFIG_ZTEST)
    add_compile_definitions(HIL_TEST=y)
    list(APPEND SOURCES_FILES
        src/voltage_measurement/voltage_measurement_tests.c
        src/optics/ir_camera_system/ir_camera_system_tests.c
        src/optics/mirror/mirror_tests.c
        src/system/dfu/dfu_tests.c
        src/temperature/fan/fan_tests.c
        src/ui/rgb_leds/front_leds/front_leds_tests.c
        src/ui/rgb_leds/operator_leds/operator_leds_tests.c
        src/pubsub/pubsub_tests.c
        )
    if (CONFIG_BOARD_DIAMOND_MAIN)
        list(APPEND SOURCES_FILES src/ui/rgb_leds/cone_leds/cone_leds_tests.c)
    endif()
else ()
    list(APPEND SOURCES_FILES
        src/pubsub/pubsub.c)
endif ()

set(INCLUDE_DIRS
    include
    src
    )

# EXTRA_COMPILE_FLAGS given via `west build -- -DEXTRA_COMPILE_FLAGS=...`
set_source_files_properties(${SOURCES_FILES} PROPERTIES COMPILE_OPTIONS "${APP_FILES_COMPILE_OPTIONS};${EXTRA_COMPILE_FLAGS}")

target_sources(${TARGET} PRIVATE ${SOURCES_FILES})
target_include_directories(${TARGET} PRIVATE ${INCLUDE_DIRS})

# link with Zephyr modules below
# - modules/orb-protobuf-definitions: data format definitions and serializer/deserializer for messages between MCU, Jetson and Security MCU
# - bootloader/mcuboot/boot/bootutil: public functions to access/modify mcuboot data from the application
if (CONFIG_ORB_MCU_MESSAGING_LIB)
    zephyr_link_libraries(ORB_MCU_MESSAGING_LIB)
    # dependency below doesn't have to be forced if using West but must be added when using CMake only
    # to build zephyr_final
    add_dependencies(app generate_proto_files)
endif ()
if (CONFIG_MCUBOOT_BOOTUTIL_LIB)
    # check path is absolute
    if (IS_ABSOLUTE ${CONFIG_MCUBOOT_SIGNATURE_KEY_FILE})
        set(MCUBOOT_SIGNATURE_KEY_FILE ${CONFIG_MCUBOOT_SIGNATURE_KEY_FILE})
    else ()
        set(MCUBOOT_SIGNATURE_KEY_FILE ${WEST_TOPDIR}/${CONFIG_MCUBOOT_SIGNATURE_KEY_FILE})
    endif ()
    if (IS_ABSOLUTE ${CONFIG_MCUBOOT_ENCRYPTION_KEY_FILE})
        set(MCUBOOT_ENCRYPTION_KEY_FILE ${CONFIG_MCUBOOT_ENCRYPTION_KEY_FILE})
    else ()
        set(MCUBOOT_ENCRYPTION_KEY_FILE ${WEST_TOPDIR}/${CONFIG_MCUBOOT_ENCRYPTION_KEY_FILE})
    endif ()
    # check if files exist
    if (NOT EXISTS "${MCUBOOT_SIGNATURE_KEY_FILE}" OR NOT EXISTS "${MCUBOOT_ENCRYPTION_KEY_FILE}")
        message(FATAL_ERROR "Missing signature files, use 'generate_dev_keys'")
    endif ()
    zephyr_link_libraries(MCUBOOT_BOOTUTIL)
endif ()

# specific target to test firmware update
# this target loads the new image in secondary slot and resets the target
# the bootloader will then swap the images before launching the new image as a Test
set(SIGNED_ENCRYPTED_BINARY ${CMAKE_BINARY_DIR}/zephyr/zephyr.signed.encrypted.bin)
add_custom_target(
    openocd_load_encrypted_sec_slot
    DEPENDS zephyr_final
    COMMAND openocd -f ${WORKSPACE_DIR}/orb/boards/arm/pearl_main/support/openocd.cfg -c "tcl_port disabled" -c "gdb_port disabled" -c "tcl_port disabled" -c "program \"${SIGNED_ENCRYPTED_BINARY}\" 0x8044000" -c reset -c shutdown
    # TODO flash "image OK" flags at the end of the secondary slot to mark image as pending
    COMMENT "Loading signed+encrypted binary into secondary slot"
)
```

## Kconfig
```
menu "Main MCU Options"

menu "Log levels"
rsource "log_levels.Kconfig"
endmenu

comment "Developer options"

config INSTA_BOOT
    bool "Boot right away without waiting for a button press"

config NO_JETSON_BOOT
    bool "Do not boot the Jetson"

config NO_SUPER_CAPS
    bool "Do not turn on super capacitor charging"

config MCU_DEVEL
    bool "Enable all developer options"
    select INSTA_BOOT
    select NO_JETSON_BOOT
    select NO_SUPER_CAPS

comment "Integration tests"

config TEST_VOLTAGE_MEASUREMENT
    bool "Test the supply voltages"

config TEST_MIRROR
    bool "Test the mirror control"

config TEST_DFU
    bool "Test device firmware upgrade"

config TEST_OPERATOR_LEDS
    bool "Test operator LEDs"

config TEST_USER_LEDS
    bool "Test user/front LEDs"
    help
      Tests all the user LED patterns. Visual inspection is needed to check
      for correct pattern implementation.

config TEST_IR_CAMERA_SYSTEM_WITH_PROBE
    bool "Test the IR camera system"
    help
      The IR/Camera test has to be verified using a scope
      or logic analyzer.

config TEST_FAN
    bool "Test fan"

config TEST_GNSS
	bool "Test GNSS frame parsing"

config APP_TESTS_ALL
    bool "Enable all integration tests"
    select TEST_VOLTAGE_MEASUREMENT
    select TEST_MIRROR
    select TEST_DFU
    select TEST_OPERATOR_LEDS
    select TEST_USER_LEDS
    select TEST_FAN
    select TEST_GNSS

config CI_INTEGRATION_TESTS
	bool "Send specific string in logs when testing UART with mcu-util"
	default false
	select NO_SUPER_CAPS
	help
	  UART communication is unidirectional and doesn't allow
	  the MCU to respond to the Jetson. To allow the Jetson to confirm
	  that the MCU is receiving its UART messages, this option configures
	  the MCU to emit a special log message when it successfully receives UART
	  communications from the Jetson. The Jetson can then look for this special
	  log message to confirm the UART channel to the MCU is working.

endmenu

menu "Zephyr Options"
source "Kconfig.zephyr"
endmenu
```

## prj.conf
```kconfig
# Common configuration for main MCU firmware

CONFIG_CLOCK_CONTROL=y
CONFIG_PINCTRL=y
CONFIG_SERIAL=y
CONFIG_GPIO=y

CONFIG_THREAD_CUSTOM_DATA=y

CONFIG_MAIN_THREAD_PRIORITY=5
CONFIG_MAIN_STACK_SIZE=2048

CONFIG_SYSTEM_WORKQUEUE_STACK_SIZE=2048

CONFIG_HEAP_MEM_POOL_SIZE=256
CONFIG_ASSERT=y
CONFIG_SPIN_VALIDATE=y

# Data structures
CONFIG_RING_BUFFER=y

# UART
CONFIG_UART_ASYNC_API=y

# Floating Point Options
CONFIG_NEWLIB_LIBC=y
CONFIG_NEWLIB_LIBC_NANO=y
CONFIG_FPU=y
CONFIG_FPU_SHARING=y

# CAN bus
CONFIG_CAN=y
CONFIG_CAN_FD_MODE=y
# automatic recovery doesn't work so recover manually
CONFIG_CAN_AUTO_BUS_OFF_RECOVERY=n
CONFIG_CAN_ADDRESS_MCU=0x01
# Jetson address
CONFIG_CAN_ADDRESS_DEFAULT_REMOTE=0x80
# 4-bit ID used to create addresses
CONFIG_CAN_ISOTP_REMOTE_ID=0x8
CONFIG_CAN_ISOTP_LOCAL_ID=0x1
CONFIG_CAN_ISOTP_MAX_SIZE_BYTES=690
# ISO-TP config, no log from ISO-TP module
CONFIG_ISOTP=y

# RX_BUF is used to receive one block. 56-byte long: BS=8 and CAN_DL-1=7, 8*7=56
CONFIG_ISOTP_RX_BUF_SIZE=56
# We need at least 10 buffers to receive messages of 560-byte long (CONFIG_ISOTP_RX_BUF_SIZE*10)
# With several rx contexts, allocate at least twice this amount
CONFIG_ISOTP_RX_BUF_COUNT=20
# We have 8 rx contexts, so allocate that amount of buffers for First Frames or Single Frames
CONFIG_ISOTP_RX_SF_FF_BUF_COUNT=8

# PWM
CONFIG_PWM_STM32=y
CONFIG_PWM=y

# ADC
CONFIG_ADC=y
CONFIG_ADC_STM32=y
CONFIG_ADC_STM32_DMA=y

# Sensors
CONFIG_SENSOR=y
CONFIG_TMP112=y
CONFIG_MAX31875=y
CONFIG_VL53L1X=y
CONFIG_VL53L1X_INTERRUPT_MODE=n
CONFIG_VL53L1X_XSHUT=n

# I2C
CONFIG_I2C=y
CONFIG_I2C_STM32=y
CONFIG_I2C_INIT_PRIORITY=60

# SPI
CONFIG_SPI=y
CONFIG_SPI_STM32_INTERRUPT=y

# Our custom modules
CONFIG_NANOPB=y
CONFIG_ORB_MCU_MESSAGING_LIB=y
CONFIG_ORB_LIB_CAN_MESSAGING=y
CONFIG_ORB_LIB_UART_MESSAGING=y
CONFIG_ORB_LIB_ERRORS=y
CONFIG_ORB_LIB_DFU=y
CONFIG_ORB_LIB_STORAGE=y
CONFIG_ORB_LIB_WATCHDOG=y
CONFIG_WATCHDOG=y
CONFIG_ORB_LIB_HEALTH_MONITORING=y
CONFIG_ORB_LIB_LOGS_CAN=y
# Same priority as CAN RX and TX threads to make sure other threads cannot block DFU
# and brick the device
CONFIG_ORB_LIB_THREAD_PRIORITY_CANBUS_RX=5
CONFIG_ORB_LIB_THREAD_PRIORITY_CANBUS_TX=5
CONFIG_ORB_LIB_THREAD_PRIORITY_DFU=6
CONFIG_ORB_LIB_THREAD_STACK_SIZE_DFU=2048

# ALS
CONFIG_BU27030=y

# DMA
CONFIG_DMA=y
CONFIG_DMA_STM32=y

# Interrupt handling
CONFIG_DYNAMIC_INTERRUPTS=y

# Bootloader
# Enable Zephyr application to be booted by MCUboot
CONFIG_BOOTLOADER_MCUBOOT=y
# Path to signature file. Must be absolute or relative to West top dir
CONFIG_MCUBOOT_SIGNATURE_KEY_FILE="orb/utils/ota/root-ec-p256.pem"
CONFIG_MCUBOOT_ENCRYPTION_KEY_FILE="orb/utils/ota/enc-ec256-pub.pem"
CONFIG_MCUBOOT_BOOTUTIL_LIB=y
CONFIG_BOOT_BANNER=n

# Flash management, needed for DFU
CONFIG_FLASH=y
CONFIG_FLASH_MAP=y
# FIXME? unfortunately, we can't use deep power down mode because then it
# takes too long to compute CRC over the image and writing to flash
# when doing DFU fails regularly
CONFIG_SPI_NOR_IDLE_IN_DPD=n

CONFIG_REBOOT=y

# entropy driver needed for STACK_CANARIES & STACK_RANDOM_POINTER in release mode
# also needed when testing errors
CONFIG_ENTROPY_GENERATOR=y

CONFIG_LED_STRIP=y
```

## debug.conf
```kconfig
# Configuration file for the main MCU firmware when compiled in Debug / Dev mode

CONFIG_DEBUG_OPTIMIZATIONS=y
# -fstore-merging is needed to reduce code used by logging subsystem
CONFIG_COMPILER_OPT="-O1 -g3 -fstore-merging"

# Debug mode
CONFIG_DEBUG=y

# Console
CONFIG_CONSOLE=y
CONFIG_UART_CONSOLE=y

# In Debug mode, Zephyr's logging is enabled
CONFIG_LOG=y
CONFIG_LOG_DEFAULT_LEVEL=2
# Switch between deferred and immediate
# Prefer the deferred mode so that the logging thread, which has the lowest priority
# runs every CONFIG_LOG_PROCESS_THREAD_SLEEP_MS in the background (doesn't take CPU time to print the log)
CONFIG_LOG_MODE_DEFERRED=y
# CONFIG_LOG_MODE_IMMEDIATE=y
# Logs over CAN
CONFIG_ORB_LIB_LOG_BACKEND_CAN=y
# Logs over UART
CONFIG_LOG_BACKEND_UART=y
CONFIG_LOG_BUFFER_SIZE=2048
CONFIG_CBPRINTF_LIBC_SUBSTS=y
CONFIG_CBPRINTF_NANO=y
CONFIG_LOG_PROCESS_THREAD=y
CONFIG_LOG_PROCESS_THREAD_SLEEP_MS=100
CONFIG_LOG_PROCESS_TRIGGER_THRESHOLD=2
CONFIG_LOG_PROCESS_THREAD_STACK_SIZE=4096
CONFIG_ORB_LIB_LOG_BACKEND_CAN=y
CONFIG_LOG_PRINTK=y
CONFIG_LOG_BACKEND_SHOW_COLOR=y

# Per module
CONFIG_KERNEL_LOG_LEVEL_WRN=y
CONFIG_POWER_SEQUENCE_LOG_LEVEL_DBG=y

# Uncomment to enable thread analyzer
# CONFIG_THREAD_ANALYZER=y
# CONFIG_THREAD_ANALYZER_USE_PRINTK=y
# CONFIG_THREAD_ANALYZER_AUTO=y
# CONFIG_THREAD_ANALYZER_AUTO_INTERVAL=5
# CONFIG_THREAD_NAME=y

# thread awareness
# openOCD with Zephyr patch is needed
CONFIG_DEBUG_THREAD_INFO=y

CONFIG_ORB_LIB_WATCHDOG=n
```

## release.conf
```kconfig
# Compiler options
CONFIG_SIZE_OPTIMIZATIONS=y

# minimal logs
CONFIG_LOG_PRINTK=n
CONFIG_PRINTK=n
CONFIG_BOOT_BANNER=n
CONFIG_CBPRINTF_NANO=y
CONFIG_LOG_MAX_LEVEL=2

# disable Zephyr asserts
CONFIG_ASSERT=n
CONFIG_SPIN_VALIDATE=n

# Security hardening for production releases
#                        name   |  current | recommended ||  check result
# =========================================================================
# CONFIG_LOG                    |     y    |      n      ||      FAIL: log through CAN backend
# CONFIG_BUILD_OUTPUT_STRIPPED  |     n    |      y      ||      FAIL: useless, we ship stripped binaries
# CONFIG_FAULT_DUMP             |     1    |      0      ||      FAIL: short dump sent through CAN
# CONFIG_STACK_SENTINEL         |     n    |      y      ||      FAIL: HW_STACK_PROTECTION is used
# CONFIG_UART_ASYNC_API         |     y    |      n      ||      FAIL: needed for Jetson->main mcu com
# Prevent overwriting the stack frame, /!\ high footprint
CONFIG_STACK_CANARIES=y
CONFIG_LOG_BACKEND_UART=n
CONFIG_PRINTK=n
# /!\ Uses 100 bytes more in threads stack
CONFIG_STACK_POINTER_RANDOM=100
CONFIG_OVERRIDE_FRAME_POINTER_DEFAULT=y
# Sentinel not used in favor of HW_STACK_PROTECTION
CONFIG_STACK_SENTINEL=n
# shorten fault dumps
CONFIG_FAULT_DUMP=1
# entropy driver needed for STACK_CANARIES & STACK_RANDOM_POINTER
CONFIG_ENTROPY_GENERATOR=y
```

## tests.conf
```kconfig
CONFIG_DEBUG_OPTIMIZATIONS=y
CONFIG_COMPILER_OPT="-O1 -g3 -fstore-merging"

# Debug mode
CONFIG_DEBUG=y

# boot without using the button
# do not boot the Jetson to run all tests
CONFIG_INSTA_BOOT=y
CONFIG_NO_JETSON_BOOT=y

# Debug-only logging settings
CONFIG_LOG_PRINTK=y
CONFIG_LOG_BACKEND_SHOW_COLOR=y
# Per module
CONFIG_KERNEL_LOG_LEVEL_WRN=y
# CONFIG_TEMPERATURE_LOG_LEVEL_DBG=y
# CONFIG_BATTERY_LOG_LEVEL_DBG=y
# CONFIG_GNSS_LOG_LEVEL_DBG=y
# CONFIG_RUNNER_LOG_LEVEL_DBG=y
# CONFIG_PUBSUB_LOG_LEVEL_DBG=y
CONFIG_UART_MESSAGING_LOG_LEVEL_INF=y
CONFIG_FRONT_UNIT_RGB_LEDS_LOG_LEVEL_INF=y
CONFIG_FAN_TACH_LOG_LEVEL_WRN=y
CONFIG_DFU_LOG_LEVEL_DBG=y
CONFIG_TOF_1D_LOG_LEVEL_WRN=y
CONFIG_ALS_LOG_LEVEL_WRN=y

# Uncomment to enable thread analyzer
# CONFIG_THREAD_ANALYZER=y
# CONFIG_THREAD_ANALYZER_USE_PRINTK=y
# CONFIG_THREAD_ANALYZER_AUTO=y
# CONFIG_THREAD_ANALYZER_AUTO_INTERVAL=5
# CONFIG_THREAD_NAME=y

CONFIG_ZTEST=y
CONFIG_ZTEST_NEW_API=y
CONFIG_ZTEST_STACK_SIZE=3000

# enable all runtime tests
# note that IR/Camera test isn't enabled
CONFIG_APP_TESTS_ALL=y
CONFIG_ORB_LIB_STORAGE_TESTS=y

# don't generate an OTA image as it won't fit anyway
CONFIG_MCUBOOT_SIGNATURE_KEY_FILE=""
CONFIG_MCUBOOT_ENCRYPTION_KEY_FILE=""
```

## boards/diamond_main.conf
```kconfig
# enable GPIO
CONFIG_GPIO_PCA95XX=y

# I2C and SPI multiplexers
CONFIG_I2C_MUX_GPIO=y
CONFIG_I2C_MUX_GLOBAL_LOCK=y
CONFIG_SPI_MUX_GPIO=y

# make sure I2C3 device is initialized before GPIO expanders
CONFIG_I2C_INIT_PRIO_INST_1=48
CONFIG_GPIO_PCA95XX_INIT_PRIORITY=49
# PCA95xx@0x23
CONFIG_PCA95XX_INIT_PRIO_INST_0=61
# SPI & muxes initialized before LED strip
CONFIG_SPI_INIT_PRIORITY=49
CONFIG_SPI_MUX_GPIO_INIT_PRIO=50
CONFIG_SPI_MUX_GPIO_CHANNEL_INIT_PRIO=51
CONFIG_LED_STRIP_INIT_PRIORITY=52
CONFIG_I2C_INIT_PRIORITY=60

CONFIG_SPI_RGB_LED=y
# SPI with DMA for LED strip
CONFIG_SPI_STM32_DMA=y
```

## boards/pearl_main.conf
```kconfig
# LED Strips
CONFIG_LED_STRIP=y
CONFIG_WS2812_PWM_STM32=y
```

## src/main.c
```c
#if defined(CONFIG_BOARD_PEARL_MAIN)
#include "gnss/gnss.h"
#endif
#include "logs_can.h"
#include "optics/optics.h"
#include "power/battery/battery.h"
#include "power/boot/boot.h"
#include "pubsub/pubsub.h"
#include "runner/runner.h"
#include "system/diag.h"
#include "system/logs.h"
#include "system/version/version.h"
#include "temperature/fan/fan.h"
#include "temperature/fan/fan_tach.h"
#include "temperature/sensors/temperature.h"
#include "ui/ambient_light/als.h"
#include "ui/button/button.h"
#include "ui/sound/sound.h"
#include "ui/ui.h"
#include "voltage_measurement/voltage_measurement.h"
#include <app_assert.h>
#include <can_messaging.h>
#include <dfu.h>
#include <fatal.h>
#include <pb_encode.h>
#include <storage.h>
#include <zephyr/device.h>
#include <zephyr/kernel.h>

#if CONFIG_ORB_LIB_WATCHDOG
#include <watchdog.h>
#endif

#ifdef CONFIG_ORB_LIB_HEALTH_MONITORING
#include "heartbeat.h"
#endif

LOG_MODULE_REGISTER(main);

static bool jetson_up_and_running = false;

static K_MUTEX_DEFINE(analog_and_i2c_mutex);

#ifdef CONFIG_ZTEST_NEW_API
#include <zephyr/ztest.h>

ZTEST_SUITE(hil, NULL, NULL, NULL, NULL, NULL);
#endif

/**
 * @brief execute ZTests or other runtime tests
 */
static void
run_tests()
{
#if defined(CONFIG_ZTEST_NEW_API)
    // Per default publishing of voltages is disabled
    // -> enable it for testing if voltage messages are published
    voltage_measurement_set_publish_period(1000);

    ztest_run_all(NULL);
    ztest_verify_all_test_suites_ran();
#endif

#if defined(CONFIG_ORB_LIB_ERRORS_TESTS)
    fatal_errors_test();
#endif
}

/**
 * Callback called in fatal assertion before system reset
 * ⚠️ No context-switch should be performed:
 *     to be provided by the caller of this function
 */
static void
app_assert_cb(fatal_error_info_t *err_info)
{
    if (jetson_up_and_running) {
        // fatal error, try to warn Jetson
        static McuMessage fatal_error = {
            .which_message = McuMessage_m_message_tag,
            .message.m_message.which_payload = McuToJetson_fatal_error_tag,
            .message.m_message.payload.fatal_error.reason =
                FatalError_FatalReason_FATAL_ASSERT_HARD,
        };

        static uint8_t buffer[CAN_FRAME_MAX_SIZE];
        pb_ostream_t stream = pb_ostream_from_buffer(buffer, sizeof(buffer));
        bool encoded = pb_encode_ex(&stream, McuMessage_fields, &fatal_error,
                                    PB_ENCODE_DELIMITED);

        can_message_t to_send = {.destination =
                                     CONFIG_CAN_ADDRESS_DEFAULT_REMOTE,
                                 .bytes = buffer,
                                 .size = stream.bytes_written};

        if (encoded) {
            // important: send in blocking mode
            (void)can_messaging_blocking_tx(&to_send);
        }
    } else if (err_info != NULL) {
        // TODO store error
    }
}

static void
send_reset_reason(void)
{
    uint32_t reset_reason = fatal_get_status_register();
    if (reset_reason != 0) {
        FatalError fatal_error = {0};
        if (IS_WATCHDOG(reset_reason)) {
            fatal_error.reason = FatalError_FatalReason_FATAL_WATCHDOG;
            publish_new(&fatal_error, sizeof(fatal_error),
                        SecToJetson_fatal_error_tag,
                        CONFIG_CAN_ADDRESS_DEFAULT_REMOTE);
        }
        if (IS_SOFTWARE(reset_reason)) {
            fatal_error.reason = FatalError_FatalReason_FATAL_SOFTWARE_UNKNOWN;
            publish_new(&fatal_error, sizeof(fatal_error),
                        SecToJetson_fatal_error_tag,
                        CONFIG_CAN_ADDRESS_DEFAULT_REMOTE);
        }
        if (IS_BOR(reset_reason)) {
            fatal_error.reason = FatalError_FatalReason_FATAL_BROWNOUT;
            publish_new(&fatal_error, sizeof(fatal_error),
                        SecToJetson_fatal_error_tag,
                        CONFIG_CAN_ADDRESS_DEFAULT_REMOTE);
        }
        if (IS_PIN(reset_reason)) {
            fatal_error.reason = FatalError_FatalReason_FATAL_PIN_RESET;
            publish_new(&fatal_error, sizeof(fatal_error),
                        SecToJetson_fatal_error_tag,
                        CONFIG_CAN_ADDRESS_DEFAULT_REMOTE);
        }
        if (IS_LOW_POWER(reset_reason)) {
            fatal_error.reason = FatalError_FatalReason_FATAL_LOW_POWER;
            publish_new(&fatal_error, sizeof(fatal_error),
                        SecToJetson_fatal_error_tag,
                        CONFIG_CAN_ADDRESS_DEFAULT_REMOTE);
        }
    }
}

__maybe_unused static void
wait_jetson_up(void)
{
    // wait for Jetson to show activity before sending our version
    while (!jetson_up_and_running) {
        k_msleep(5000);

        // as soon as the Jetson sends the first message, send firmware version
        if (runner_successful_jobs_count() > 0) {
            version_fw_send(CONFIG_CAN_ADDRESS_DEFAULT_REMOTE);

            uint32_t error_count = app_assert_soft_count();
            if (error_count) {
                LOG_ERR("Error count during boot: %u", error_count);
            }

            send_reset_reason();

            jetson_up_and_running = true;
        }
    }
}

void
initialize(void)
{
    int err_code;

    fatal_init();
    diag_init();

    LOG_INF("🚀");

    err_code = storage_init();
    ASSERT_SOFT(err_code);

    // initialize runner before communication modules
    runner_init();

    app_assert_init(app_assert_cb);

#if CONFIG_ORB_LIB_WATCHDOG
    err_code = watchdog_init();
    ASSERT_SOFT(err_code);
#endif

#if CONFIG_ORB_LIB_CAN_MESSAGING
    err_code = can_messaging_init(runner_handle_new_can);
    ASSERT_SOFT(err_code);
#endif

#if CONFIG_ORB_LIB_UART_MESSAGING
    err_code = uart_messaging_init(runner_handle_new_uart);
    ASSERT_SOFT(err_code);
#endif

    err_code = version_init();
    ASSERT_SOFT(err_code);

    Hardware hw = {.version = version_get_hardware_rev()};
    LOG_INF("Hardware version: %u", hw.version);

    // voltage_measurement module is used by battery and boot -> must be
    // initialized before
    err_code = voltage_measurement_init(&hw, &analog_and_i2c_mutex);
    ASSERT_SOFT(err_code);

    // logs over CAN must be initialized after CAN-messaging module
    err_code = logs_init(logs_can);
    ASSERT_SOFT(err_code);

    // check battery state early on
    err_code = battery_init();
    ASSERT_SOFT(err_code);

#ifndef CONFIG_NO_JETSON_BOOT
    err_code = boot_turn_on_jetson();
    ASSERT_SOFT(err_code);
#endif // CONFIG_NO_JETSON_BOOT

    err_code = fan_init();
    ASSERT_SOFT(err_code);

    temperature_init(&hw, &analog_and_i2c_mutex);

    err_code = sound_init();
    ASSERT_SOFT(err_code);

    err_code = ui_init();
    ASSERT_SOFT(err_code);

#if !defined(CONFIG_NO_SUPER_CAPS) && !defined(CONFIG_CI_INTEGRATION_TESTS)
    err_code = boot_turn_on_super_cap_charger();
    if (err_code == RET_SUCCESS) {
        err_code = boot_turn_on_pvcc();
        if (err_code == RET_SUCCESS) {
            err_code = optics_init(&hw);
            ASSERT_SOFT(err_code);
        } else {
            ASSERT_SOFT(err_code);
        }
    } else {
        ASSERT_SOFT(err_code);
    }
#else
    err_code = optics_init(&hw);
    ASSERT_SOFT(err_code);
#endif // CONFIG_NO_SUPER_CAPS

    err_code = als_init(&analog_and_i2c_mutex);
    ASSERT_SOFT(err_code);

    err_code = dfu_init();
    ASSERT_SOFT(err_code);

    err_code = button_init();
    ASSERT_SOFT(err_code);

#if defined(CONFIG_BOARD_PEARL_MAIN)
    err_code = gnss_init();
    ASSERT_SOFT(err_code);
#endif

    err_code = fan_tach_init();
    ASSERT_SOFT(err_code);
}

#ifdef CONFIG_ZTEST
void
test_main(void)
{
    initialize();
    run_tests();
}
#else
int
main(void)
{
    initialize();
    run_tests();
    wait_jetson_up();

    return 0;
}
#endif
```

## include/app_config.h
```c
#pragma once

///////////////////////////////////////
/// Threads ordered by priorities   ///
///////////////////////////////////////

// work queue CONFIG_SYSTEM_WORKQUEUE_PRIORITY = -1

/// See other threads configured with KConfig: CONFIG_ORB_LIB_THREAD_*

// Power management thread
#define THREAD_PRIORITY_POWER_MANAGEMENT   3
#define THREAD_STACK_SIZE_POWER_MANAGEMENT 2048

// Runner / default message processing
#define THREAD_PRIORITY_RUNNER   6
#define THREAD_STACK_SIZE_RUNNER 2048

// Front unit RGB LEDs
#define THREAD_PRIORITY_FRONT_UNIT_RGB_LEDS 7
#if defined(CONFIG_BOARD_DIAMOND_MAIN)
#define THREAD_STACK_SIZE_FRONT_UNIT_RGB_LEDS 1024
#else
#define THREAD_STACK_SIZE_FRONT_UNIT_RGB_LEDS 512
#endif

// Operator RGB LEDs
#define THREAD_PRIORITY_OPERATOR_RGB_LEDS 7
#if defined(CONFIG_BOARD_DIAMOND_MAIN)
#define THREAD_STACK_SIZE_OPERATOR_RGB_LEDS 1024
#else
#define THREAD_STACK_SIZE_OPERATOR_RGB_LEDS 512
#endif

#if defined(CONFIG_BOARD_DIAMOND_MAIN)
// Cone RGB LEDs
#define THREAD_PRIORITY_CONE_RGB_LEDS   7
#define THREAD_STACK_SIZE_CONE_RGB_LEDS 1024

// Cone button
#define THREAD_PRIORITY_CONE_BUTTON   8
#define THREAD_STACK_SIZE_CONE_BUTTON 592

// white LEDs
#define THREAD_PRIORITY_WHITE_LEDS   9
#define THREAD_STACK_SIZE_WHITE_LEDS 512
#endif

// Liquid Lens
#define THREAD_PRIORITY_LIQUID_LENS   7
#define THREAD_STACK_SIZE_LIQUID_LENS 512

// Temperature
#define THREAD_PRIORITY_TEMPERATURE   8
#define THREAD_STACK_SIZE_TEMPERATURE 2048

// Fan Tachometer
#define THREAD_PRIORITY_FAN_TACH   8
#define THREAD_STACK_SIZE_FAN_TACH 512

// 1D ToF
#define THREAD_PRIORITY_1DTOF   8
#define THREAD_STACK_SIZE_1DTOF 2048

// ALS
#define THREAD_PRIORITY_ALS   8
#define THREAD_STACK_SIZE_ALS 2048

#define THREAD_PRIORITY_MOTORS_INIT 8

#define THREAD_PRIORITY_BATTERY   8
#define THREAD_STACK_SIZE_BATTERY 2048

// Publish stored messages
#define THREAD_PRIORITY_PUB_STORED   9
#define THREAD_STACK_SIZE_PUB_STORED 2048

#define THREAD_PRIORITY_GNSS   9
#define THREAD_STACK_SIZE_GNSS 2048

#define THREAD_PRIORITY_VOLTAGE_MEASUREMENT_ADC1   8
#define THREAD_STACK_SIZE_VOLTAGE_MEASUREMENT_ADC1 512

#define THREAD_PRIORITY_VOLTAGE_MEASUREMENT_ADC4   8
#define THREAD_STACK_SIZE_VOLTAGE_MEASUREMENT_ADC4 512

#define THREAD_PRIORITY_VOLTAGE_MEASUREMENT_ADC5   8
#define THREAD_STACK_SIZE_VOLTAGE_MEASUREMENT_ADC5 512

#define THREAD_PRIORITY_VOLTAGE_MEASUREMENT_DEBUG   10
#define THREAD_STACK_SIZE_VOLTAGE_MEASUREMENT_DEBUG 1024

#define THREAD_PRIORITY_VOLTAGE_MEASUREMENT_PUBLISH   9
#define THREAD_STACK_SIZE_VOLTAGE_MEASUREMENT_PUBLISH 2048

// Testing threads
// - CAN
// - DFU
#define THREAD_PRIORITY_TESTS 9

// IR camera system test
#define THREAD_PRIORITY_IR_CAMERA_SYSTEM_TEST   9
#define THREAD_STACK_SIZE_IR_CAMERA_SYSTEM_TEST 512

// main thread priority                 10
// logging thread priority              14

#define SYS_INIT_I2C_MUX_PRIORITY 99

#define SYS_INIT_UI_LEDS_PRIORITY               55
#define SYS_INIT_POWER_SUPPLY_INIT_PRIORITY     54
#define SYS_INIT_WAIT_FOR_BUTTON_PRESS_PRIORITY 53
#define SYS_INIT_GPIO_CONFIG_PRIORITY           52

///////////////////////////////////////
/// CAN bus config                  ///
///////////////////////////////////////

#ifndef CONFIG_CAN_ADDRESS_MCU
#define CONFIG_CAN_ADDRESS_MCU 0x01
#endif

#define CAMERA_SWEEP_INTERRUPT_PRIO     10
#define LED_940NM_GLOBAL_INTERRUPT_PRIO 11
#define LED_850NM_GLOBAL_INTERRUPT_PRIO 11
```
